## firmware/zephyr_app/west.yml
```yaml
manifest:
  version: 0.12
  manifest:
    version: 0.12
    projects:
      - name: zephyr
        url: https://github.com/zephyrproject-rtos/zephyr.git
        revision: main
        path: zephyr
    self:
      path: zephyr_app
      repo-path: hal_nxp
      remote: nxp
      revision: main
      path: modules/hal/nxp
```
